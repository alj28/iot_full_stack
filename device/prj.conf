## CMakeLists.txt
```
cmake_minimum_required(VERSION 3.20.0)
find_package(Zephyr REQUIRED HINTS $ENV{ZEPHYR_BASE})
project(device)

# Verify that this samnple is built through sysbuild to ensure MCUboot is
# automatically included and that sample specific MCUboot configurations are
# used when building MCUboot.
test_sysbuild()

target_sources(
    app 
    PRIVATE 
    src/main.c
    src/commands.c
    src/utils.c
    src/utils_settings.c
    src/system.c
    src/system_shell.c
    src/system_settings.c
)

target_include_directories(
    app
    PUBLIC
    src/
)

add_subdirectory(src/communication)
if(${BOARD} STREQUAL "nrf52840dk")
    add_subdirectory(src/ui)
endif()

add_subdirectory(src/sensors)
```

## west.yml
```
manifest:
  remotes:
    - name: sdk
      url-base: https://github.com/nrfconnect

  projects:
    - name: sdk-nrf
      remote: sdk
      revision: v2.7.0
      path: nrf
      import:
        name-blocklist: []
      clone-depth: 1
```

## prj.conf
```kconfig
CONFIG_PRINTK=y

CONFIG_SHELL=y

CONFIG_LOG=y
CONFIG_LOG_CMDS=y
CONFIG_LOG_BACKEND_UART=y

CONFIG_INIT_STACKS=y
CONFIG_THREAD_STACK_INFO=y
CONFIG_THREAD_MONITOR=y
CONFIG_THREAD_NAME=y
CONFIG_THREAD_RUNTIME_STATS=y
CONFIG_THREAD_RUNTIME_STATS_USE_TIMING_FUNCTIONS=y

CONFIG_KERNEL_SHELL=y

CONFIG_DEVICE_SHELL=y

CONFIG_STATS=y
CONFIG_STATS_SHELL=y

CONFIG_ZBUS=y
CONFIG_ZBUS_CHANNEL_NAME=n
CONFIG_ZBUS_OBSERVER_NAME=n
CONFIG_ZBUS_MSG_SUBSCRIBER=y
CONFIG_HEAP_MEM_POOL_SIZE=1024
CONFIG_ZBUS_MSG_SUBSCRIBER_NET_BUF_POOL_SIZE=32

CONFIG_NVS=y
CONFIG_FLASH=y
CONFIG_FLASH_MAP=y
CONFIG_SETTINGS=y
CONFIG_SETTINGS_RUNTIME=y
CONFIG_SETTINGS_NVS=y
```

## boards/native_posix.conf
```kconfig
CONFIG_NATIVE_POSIX_SLOWDOWN_TO_REAL_TIME=y

CONFIG_UART_NATIVE_POSIX=y
CONFIG_NATIVE_UART_0_ON_OWN_PTY=y

CONFIG_NETWORKING=y
CONFIG_NET_LOG=y
CONFIG_NET_IPV4=y
CONFIG_NET_IPV6=y
CONFIG_NET_TCP=y
CONFIG_NET_DHCPV4=n
CONFIG_NET_CONFIG_SETTINGS=y
CONFIG_NET_CONFIG_MY_IPV4_ADDR="192.0.2.1"
#CONFIG_NET_CONFIG_PEER_IPV4_ADDR="192.0.2.2"
CONFIG_NET_CONFIG_MY_IPV4_GW="192.0.2.2"    # this must match to IP address of zeth TAP interface!
CONFIG_NET_BUF_RX_COUNT=100
CONFIG_NET_SOCKETS_POSIX_NAMES=y


CONFIG_NET_SOCKETS=y
CONFIG_NET_SOCKETS_SOCKOPT_TLS=y
CONFIG_MQTT_LIB=y
CONFIG_MQTT_LIB_TLS=n

CONFIG_JSON_LIBRARY=y
#CONFIG_NET_CONNECTION_MANAGER=y

CONFIG_POSIX_API=y
CONFIG_NET_SHELL=y

CONFIG_CJSON_LIB=y

CONFIG_ENTROPY_GENERATOR=y
CONFIG_TEST_RANDOM_GENERATOR=y

#CONFIG_NET_IF_LOG_LEVEL_DBG=y
#CONFIG_NET_DEBUG=y

CONFIG_FLASH_SIMULATOR=y
```

## boards/nrf52840dk_nrf52840.conf
```kconfig
CONFIG_POSIX_CLOCK=y
CONFIG_DATE_SHELL=y

CONFIG_BOOTLOADER_MCUBOOT=y

CONFIG_ZIGBEE=y
CONFIG_ZIGBEE_ROLE_END_DEVICE=y
CONFIG_ZIGBEE_CHANNEL_SELECTION_MODE_MULTI=y
CONFIG_ZBOSS_ERROR_PRINT_TO_LOG=y
CONFIG_ZIGBEE_APP_UTILS=y
CONFIG_ZIGBEE_SHELL=y

CONFIG_CRYPTO=y
CONFIG_CRYPTO_NRF_ECB=y
CONFIG_CRYPTO_INIT_PRIORITY=80

CONFIG_NET_IPV6=n
CONFIG_NET_IP_ADDR_CHECK=n
CONFIG_NET_UDP=n
```

## src/main.c
```c
#include <stdio.h>

#include <zephyr/kernel.h>
#include <zephyr/logging/log.h>

#include "board_utils.h"


#define SLEEP_TIME_MS	100UL

LOG_MODULE_REGISTER(main, LOG_LEVEL_INF);


int main(void)
{
	LOG_INF("Application image boots up.");
	//LOG_INF("Address of sample %p\n", (void *)__rom_region_start);



	while (1) 
	{
		//printf("Test\r\n");

		k_msleep(SLEEP_TIME_MS);
		POSIX_SPECIFIC_SECTION({
			k_cpu_idle();
		})
	}
	return 0;
}
```

## src/board_utils.h
```c
#ifndef _BOARD_UTILS_H_
#define _BOARD_UTILS_H_

#if defined(CONFIG_ARCH_POSIX)
    #define POSIX_SPECIFIC_SECTION(code)        code
#else
    #define POSIX_SPECIFIC_SECTION(code)
#endif




#endif /* _BOARD_UTILS_H_ */
```

## src/commands.c
```c
#include "commands.h"
```

## src/commands.h
```c
#ifndef _COMMANDS_H_
#define _COMMANDS_H_


#endif /* _COMMANDS_H_ */
```

## src/heap.c
```c
#include <zephyr/kernel.h>
#include <zephyr/shell/shell.h>
#include <zephyr/sys/sys_heap.h>

extern struct sys_heap _system_heap;

static int cmd_heap_info(const struct shell *shell, size_t argc, char **argv)
{
    struct sys_memory_stats info;
    sys_heap_runtime_stats_get(&_system_heap, &info);

    shell_print(shell, "Free: %u bytes", info.free_bytes);
    shell_print(shell, "Allocated: %u bytes", info.allocated_bytes);
    shell_print(shell, "Max allocated: %u bytes", info.max_allocated_bytes);

    return 0;
}

SHELL_CMD_REGISTER(heap_info, NULL, "Prints the free heap size", cmd_heap_info);
```

## src/system.c
```c
#include <zephyr/kernel.h>
#include <zephyr/logging/log.h>
#include <zephyr/zbus/zbus.h>

#include "system.h"
#include "system_private.h"

LOG_MODULE_REGISTER(system, LOG_LEVEL_INF);

#define DEFAULT_SW_ID           0x00000001          //  ID 1
#define DEFAULT_SW_VERSION      0x01000101          //  version 1.1.1
#define DEFAULT_HW_ID           0x00000001          //  board ID 1
#define DEFAULT_HW_VERSION      0x01000000          //  version 1.0.0
#define DEFAULT_SERIAL_NUMBER   0x12345678          //  default serial number

#define DEFAULT_ERROR_REG       0x00000000

static const system_identification_msg_t id_msg = {
    .sw_id = DEFAULT_SW_ID,
    .sw_version = DEFAULT_SW_VERSION,
    .hw_id = DEFAULT_HW_ID,
    .hw_version = DEFAULT_HW_VERSION,
    .serial_no = DEFAULT_SERIAL_NUMBER
};

static const char* const msg_names[eSYSTEM_MSG_LAST] = {
    [eSYSTEM_MSG_STATUS] = "status",
    [eSYSTEM_MSG_IDENTIFICATION] = "identification"
};

const char* get_system_msg_name(eSYSTEM_MSG_t msg) {
    if (eSYSTEM_MSG_ERROR != msg) {
        return msg_names[msg];
    }
    return NULL;
}

ZBUS_CHAN_DEFINE(
    system_chan,
    system_msg_t,
    NULL,
    NULL,
    ZBUS_OBSERVERS(communication_hub_system_subscriber),
    ZBUS_MSG_INIT(.msg = eSYSTEM_MSG_LAST)
)

static int publish_to_system_channel(const system_msg_t* msg) {
    return zbus_chan_pub(&system_chan, (void*)msg, K_SECONDS(1));
}

int send_identification_msg(void) {
    system_msg_t msg = {.msg = eSYSTEM_MSG_IDENTIFICATION};
    memcpy((void*)&msg.payload.identification, (void*)&id_msg, sizeof(system_identification_msg_t));
    return publish_to_system_channel(&msg);
}

static int init_early(void) {
    return 0;
}

static int init_very_late(void) {
    return send_identification_msg();
}

SYS_INIT_NAMED(system_early, init_early, APPLICATION, 10);
SYS_INIT_NAMED(system_very_late, init_very_late, APPLICATION, 90);
```

## src/system.h
```c
#ifndef _SYSTEM_H_
#define _SYSTEM_H_

#include <stdint.h>

typedef enum
{
    eSM_STATE_INIT = 0,
    eSM_STATE_RUNNING = 1,
    eSM_STATE_TEST = 2,
    eSM_STATE_ERROR = 3,
    eSM_STATE_SHUTDOWN = 4,
    eSM_STATE_LAST = UINT16_MAX
} eSYSTEM_STATE_t;

typedef struct
{
    uint32_t sw_id;
    uint32_t sw_version;
    uint32_t hw_id;
    uint32_t hw_version;
    uint32_t serial_no;
} system_identification_msg_t;

typedef struct
{
    uint64_t up_time_ms;
    uint32_t error_reg;
    uint16_t system_state;
    uint16_t battery_level_mV;
} system_status_msg_t;

typedef enum
{
    eSYSTEM_MSG_STATUS = 0,
    eSYSTEM_MSG_IDENTIFICATION,
    eSYSTEM_MSG_LAST,
    eSYSTEM_MSG_ERROR = eSYSTEM_MSG_LAST
} eSYSTEM_MSG_t;

typedef struct
{
    eSYSTEM_MSG_t msg;
    union {
        system_status_msg_t status;
        system_identification_msg_t identification;
    } payload;
} system_msg_t;

const char* get_system_msg_name(eSYSTEM_MSG_t msg);


#endif /* _SYSTEM_H_ */
```

## src/system_private.h
```c
#ifndef _SYSTEM_PRIVATE_H_
#define _SYSTEM_PRIVATE_H_

#include <stdint.h>

#include "utils_settings.h"
typedef enum
{
    eSYSTEM_SETTING_ID_SERIAL_NUMBER = 0,
    eSYSTEM_SETTING_ID_SW_ID,
    eSYSTEM_SETTING_ID_SW_VERSION,
    eSYSTEM_SETTING_ID_HW_ID,
    eSYSTEM_SETTING_ID_HW_VERSION,

    eSYSTEM_SETTING_ID_LAST,
    eSYSTEM_SETTING_ID_ERROR = eSYSTEM_SETTING_ID_LAST
}eSYSTEM_SETTING_ID_t;

extern settings_handler_t system_settings_handler;

int send_identification_msg(void);


#endif /* _SYSTEM_PRIVATE_H_ */
```

## src/system_settings.c
```c
#include <stdio.h>

#include <zephyr/kernel.h>
#include <zephyr/logging/log.h>
#include <zephyr/zbus/zbus.h>
#include <zephyr/settings/settings.h>

#include "system.h"
#include "system_private.h"
#include "utils_settings.h"

LOG_MODULE_REGISTER(system_settings, LOG_LEVEL_INF);

#define SETTINGS_SUBSYSTEM_KEY          "system"


#define SETTING_DEFAULT_VALUE_SERIAL_NUMBER         (0x00000000UL)
#define SETTING_DEFAULT_VALUE_SW_ID                 (0x00000001UL)
#define SETTING_DEFAULT_VALUE_SW_VERSION            (0x00000001UL)
#define SETTING_DEFAULT_VALUE_HW_ID                 (0x00000001UL)
#define SETTING_DEFAULT_VALUE_HW_VERSION            (0x00000001UL)

static settings_info_t settings_list[eSYSTEM_SETTING_ID_LAST] = {
    [eSYSTEM_SETTING_ID_SERIAL_NUMBER] = {
        .nvm_name = "serial_number",
        .storage_type = eSETTING_STORAGE_TYPE_RW,
        .dtype = eSETTING_DTYPE_UINT32,
        .value.uint32 = SETTING_DEFAULT_VALUE_SERIAL_NUMBER,
        .dvalue.uint32 = SETTING_DEFAULT_VALUE_SERIAL_NUMBER,
    },
    [eSYSTEM_SETTING_ID_SW_ID] = {
        .nvm_name = "sw_id",
        .storage_type = eSETTING_STORAGE_TYPE_RO,
        .dtype = eSETTING_DTYPE_UINT32,
        .value.uint32 = SETTING_DEFAULT_VALUE_SW_ID,
        .dvalue.uint32 = SETTING_DEFAULT_VALUE_SW_ID,
    },
    [eSYSTEM_SETTING_ID_SW_VERSION] = {
        .nvm_name = "sw_version",
        .storage_type = eSETTING_STORAGE_TYPE_RO,
        .dtype = eSETTING_DTYPE_UINT32,
        .value.uint32 = SETTING_DEFAULT_VALUE_SW_VERSION,
        .dvalue.uint32 = SETTING_DEFAULT_VALUE_SW_VERSION,
    },
    [eSYSTEM_SETTING_ID_HW_ID] = {
        .nvm_name = "hw_id",
        .storage_type = eSETTING_STORAGE_TYPE_RW,
        .dtype = eSETTING_DTYPE_UINT32,
        .value.uint32 = SETTING_DEFAULT_VALUE_HW_ID,
        .dvalue.uint32 = SETTING_DEFAULT_VALUE_HW_ID,
    },
    [eSYSTEM_SETTING_ID_HW_VERSION] = {
        .nvm_name = "hw_version",
        .storage_type = eSETTING_STORAGE_TYPE_RW,
        .dtype = eSETTING_DTYPE_UINT32,
        .value.uint32 = SETTING_DEFAULT_VALUE_HW_VERSION,
        .dvalue.uint32 = SETTING_DEFAULT_VALUE_HW_VERSION,
    },
};

settings_handler_t system_settings_handler = {
    .subsys_key = SETTINGS_SUBSYSTEM_KEY,
    .list = settings_list,
    .len = eSYSTEM_SETTING_ID_LAST
};

static int load_cb(const char *name, size_t len, settings_read_cb read_cb, void *cb_arg) {
    return setting_set_handler(name, len, read_cb, cb_arg, &system_settings_handler);
}


SETTINGS_STATIC_HANDLER_DEFINE(
    system_settings_handler,
    SETTINGS_SUBSYSTEM_KEY,
    NULL,
    load_cb,
    NULL,
    NULL
);


static int init_early(void) {
    int rc = settings_load_subtree(SETTINGS_SUBSYSTEM_KEY);
    if (0 != rc) {
        LOG_ERR("Error while loading settings subsystem.");
        return rc;
    }
    return 0;
}

SYS_INIT_NAMED(system_early, init_early, APPLICATION, 11);
```

## src/system_settings_2.c
```c
#include <zephyr/kernel.h>
#include <zephyr/logging/log.h>
#include <zephyr/zbus/zbus.h>
#include <zephyr/settings/settings.h>

#include "system.h"
#include "system_private.h"

LOG_MODULE_REGISTER(system_settings, LOG_LEVEL_INF);

typedef enum
{
    eSETTINGS_KEY_SERIAL_NUMBER = 0,
    eSETTINGS_KEY_LAST,
    eSETTINGS_KEY_ERROR = eSETTINGS_KEY_LAST
}eSETTINGS_KEY_t;

typedef struct
{
    const char* name;
    size_t size;
} settings_info_t;

static const settings_info_t settings_info[eSETTINGS_KEY_LAST] = {
    [eSETTINGS_KEY_SERIAL_NUMBER] = {.name = "serial_number", .size = sizeof(uint32_t)}
};

uint32_t serial_number_value = 0UL;
static int serial_number_set_handle(const char *name, size_t len, settings_read_cb read_cb, void *cb_arg) {
    return read_cb(cb_arg, &serial_number_value, sizeof(serial_number_value));
}
static struct settings_handler serial_number = {
    .name = settings_info[eSETTINGS_KEY_SERIAL_NUMBER].name,
    .h_set = serial_number_set_handle
};
int set_serial_number(uint32_t value) {
    int rc = settings_save_one(settings_info[eSETTINGS_KEY_SERIAL_NUMBER].name, (void*)value, settings_info[eSETTINGS_KEY_SERIAL_NUMBER].size);
    if (0 == rc) {
        serial_number_value = value;
    }
    return rc;
}

uint32_t get_serial_number(void) {
    return serial_number_value;
}


static int init_early(void) {
    int rc = settings_subsys_init();
    if (0 != rc) {
        LOG_ERR("Settings init error %d", rc);
        return rc;
    }
    rc = settings_register(&serial_number);
    if (0 != rc) {
        LOG_ERR("Settings register error %d", rc);
        return rc;
    }
    rc = settings_load();
    if (0 != rc) {
        LOG_ERR("Settings load error %d", rc);
        return rc;
    }
    return 0;
}

SYS_INIT_NAMED(system_early, init_early, APPLICATION, 10);
```

## src/system_shell.c
```c
#include <zephyr/kernel.h>
#include <zephyr/logging/log.h>
#include <zephyr/zbus/zbus.h>
#include <zephyr/shell/shell.h>

#include "system.h"
#include "system_private.h"
#include "utils.h"

LOG_MODULE_REGISTER(system_shell, LOG_LEVEL_INF);

static int send_identification_cmd_handler(const struct shell *sh, size_t argc, char **argv) {
    return send_identification_msg();
}

SHELL_STATIC_SUBCMD_SET_CREATE(
    send_subcmds,
    SHELL_CMD(identification, NULL, "Send identification message.", send_identification_cmd_handler),
    SHELL_SUBCMD_SET_END
);

int set_serial_number(uint32_t value) { return setting_set(&system_settings_handler, eSYSTEM_SETTING_ID_SERIAL_NUMBER, (setting_value_t){.uint32 = value});   }
static int set_serial_number_cmd_handler(const struct shell *sh, size_t argc, char **argv) {
    return utils_single_uint32_arg_shell_cmd(sh, argc, argv, set_serial_number);
}

SHELL_STATIC_SUBCMD_SET_CREATE(
    system_settings_set_shell_subcmds,
    SHELL_CMD(serial_number, NULL, "Serial number", set_serial_number_cmd_handler),
    SHELL_SUBCMD_SET_END
);

uint32_t get_serial_number(void) {  return setting_get_value(&system_settings_handler, eSYSTEM_SETTING_ID_SERIAL_NUMBER).uint32; }
static int get_serial_number_cmd_handler(const struct shell *sh, size_t argc, char **argv) {
    return utils_single_uint32_ret_shell_cmd(sh, argc, argv, get_serial_number);
}

SHELL_STATIC_SUBCMD_SET_CREATE(
    system_settings_get_shell_subcmds,
    SHELL_CMD(serial_number, NULL, "Serial number", get_serial_number_cmd_handler),
    SHELL_SUBCMD_SET_END
);

SHELL_STATIC_SUBCMD_SET_CREATE(
    system_shell_subcmds,
    SHELL_CMD(send, &send_subcmds, "Send message over network.", NULL),
    SHELL_CMD(set, &system_settings_set_shell_subcmds, "Set run-time variables.", NULL),
    SHELL_CMD(get, &system_settings_get_shell_subcmds, "Get run-time variables.", NULL),
    SHELL_SUBCMD_SET_END
);

SHELL_CMD_REGISTER(
    system,
    &system_shell_subcmds,
    "System commands.",
    NULL
);
```

## src/utils.c
```c
#include <stdlib.h>

#include <zephyr/shell/shell.h>

#include "utils.h"

int utils_single_int16_arg_shell_cmd(const struct shell *sh, size_t argc, char **argv, void *setter) {
    int err_count = 0;

    if ((1+1) != argc) {
        shell_error(sh, "Invalid number of arguments.");
        return -EINVAL;
    }

    int value_int = atoi(argv[1]);
    if ((value_int < INT16_MIN) || (value_int > INT16_MAX)) {
        shell_error(sh, "Argument value %d out of int16_t range.", value_int);
        err_count++;
    }
    
    if (NULL == setter) {
        shell_error(sh, "Run-time error. No setter function.");
        err_count++;
    }

    if (0 == err_count) {
        int16_t value_int16 = (int16_t)value_int;
        utils_single_int16_t_setter fp_setter = (utils_single_int16_t_setter)setter;
        err_count = fp_setter(value_int16);
    }

    if (0 == err_count) {
        shell_print(sh, "OK");
    } else {
        shell_error(sh, "NOK");
    }

    return (0 != err_count) ? (-EINVAL) : (0);
}

int utils_single_uint16_arg_shell_cmd(const struct shell *sh, size_t argc, char **argv, void *setter) {
    int err_count = 0;

    if ((1+1) != argc) {
        shell_error(sh, "Invalid number of arguments.");
        return -EINVAL;
    }

    int value_int = atoi(argv[1]);
    if ((value_int < 0) || (value_int > UINT16_MAX)) {
        shell_error(sh, "Argument value %d out of uint16_t range.", value_int);
        err_count++;
    }
    
    if (NULL == setter) {
        shell_error(sh, "Run-time error. No setter function.");
        err_count++;
    }

    if (0 == err_count) {
        uint16_t value_uint16 = (int16_t)value_int;
        utils_single_uint16_t_setter fp_setter = (utils_single_uint16_t_setter)setter;
        err_count = fp_setter(value_uint16);
    }

    if (0 == err_count) {
        shell_print(sh, "OK");
    } else {
        shell_error(sh, "NOK");
    }

    return (0 != err_count) ? (-EINVAL) : (0);
}

int utils_single_uint32_arg_shell_cmd(const struct shell *sh, size_t argc, char **argv, void *setter) {
    int err_count = 0;

    if ((1+1) != argc) {
        shell_error(sh, "Invalid number of arguments.");
        return -EINVAL;
    }

    int value_int = atoi(argv[1]);
    if ((value_int < 0) || (value_int > UINT32_MAX)) {
        shell_error(sh, "Argument value %d out of uint32_t range.", value_int);
        err_count++;
    }
    
    if (NULL == setter) {
        shell_error(sh, "Run-time error. No setter function.");
        err_count++;
    }

    if (0 == err_count) {
        uint32_t value_uint32 = (int16_t)value_int;
        utils_single_uint32_t_setter fp_setter = (utils_single_uint32_t_setter)setter;
        err_count = fp_setter(value_uint32);
    }

    if (0 == err_count) {
        shell_print(sh, "OK");
    } else {
        shell_error(sh, "NOK");
    }

    return (0 != err_count) ? (-EINVAL) : (0);
}

int utils_single_int16_ret_shell_cmd(const struct shell *sh, size_t argc, char **argv, void *getter) {
    int err_count = 0;
    
    if (NULL == getter) {
        shell_error(sh, "Run-time error. No setter function.");
        err_count++;
    }

    if (0 == err_count) {
        utils_single_int16_t_getter fp_getter = (utils_single_int16_t_getter)getter;
        int16_t value = fp_getter();
        shell_print(sh, "%d", value);
    }

    if (0 == err_count) {
        shell_print(sh, "OK");
    } else {
        shell_error(sh, "NOK");
    }

    return (0 != err_count) ? (-EINVAL) : (0);
}

int utils_single_uint16_ret_shell_cmd(const struct shell *sh, size_t argc, char **argv, void *getter) {
    int err_count = 0;
    
    if (NULL == getter) {
        shell_error(sh, "Run-time error. No setter function.");
        err_count++;
    }

    if (0 == err_count) {
        utils_single_uint16_t_getter fp_getter = (utils_single_uint16_t_getter)getter;
        uint16_t value = fp_getter();
        shell_print(sh, "%d", value);
    }

    if (0 == err_count) {
        shell_print(sh, "OK");
    } else {
        shell_error(sh, "NOK");
    }

    return (0 != err_count) ? (-EINVAL) : (0);
}

int utils_single_uint32_ret_shell_cmd(const struct shell *sh, size_t argc, char **argv, void *getter) {
    int err_count = 0;
    
    if (NULL == getter) {
        shell_error(sh, "Run-time error. No setter function.");
        err_count++;
    }

    if (0 == err_count) {
        utils_single_uint32_t_getter fp_getter = (utils_single_uint32_t_getter)getter;
        uint32_t value = fp_getter();
        shell_print(sh, "%d", value);
    }

    if (0 == err_count) {
        shell_print(sh, "OK");
    } else {
        shell_error(sh, "NOK");
    }

    return (0 != err_count) ? (-EINVAL) : (0);
}
```

## src/utils.h
```c
#ifndef _UTILS_H_
#define _UTILS_H_

#include <stdint.h>

typedef int(*utils_single_int16_t_setter)(int16_t value);
int utils_single_int16_arg_shell_cmd(const struct shell *sh, size_t argc, char **argv, void *setter);

typedef int(*utils_single_uint16_t_setter)(uint16_t value);
int utils_single_uint16_arg_shell_cmd(const struct shell *sh, size_t argc, char **argv, void *setter);

typedef int(*utils_single_uint32_t_setter)(uint32_t value);
int utils_single_uint32_arg_shell_cmd(const struct shell *sh, size_t argc, char **argv, void *setter);

typedef int(*utils_single_int16_t_getter)(void);
int utils_single_int16_ret_shell_cmd(const struct shell *sh, size_t argc, char **argv, void *getter);

typedef int(*utils_single_uint16_t_getter)(void);
int utils_single_uint16_ret_shell_cmd(const struct shell *sh, size_t argc, char **argv, void *getter);

typedef uint32_t(*utils_single_uint32_t_getter)(void);
int utils_single_uint32_ret_shell_cmd(const struct shell *sh, size_t argc, char **argv, void *getter);

#endif /* _UTILS_H_ */
```
